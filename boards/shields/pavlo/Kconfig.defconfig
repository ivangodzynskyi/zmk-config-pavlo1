## boards/shields/pavlo/Kconfig.defconfig
```kconfig
if SHIELD_PAVLO_LEFT

config ZMK_KEYBOARD_NAME
    default "pavlo"

config ZMK_SPLIT_ROLE_CENTRAL
    default y

endif

if SHIELD_PAVLO_LEFT || SHIELD_PAVLO_RIGHT

config ZMK_SPLIT
    default y
endif
```

## boards/shields/pavlo/Kconfig.shield
```kconfig
config SHIELD_PAVLO_LEFT
    def_bool $(shields_list_contains, pavlo_left)

config SHIELD_PAVLO_RIGHT
    def_bool $(shields_list_contains, pavlo_right)
```

## boards/shields/pavlo1/Kconfig.shield
```kconfig
# Copyright (c) 2020 The ZMK Contributors
# SPDX-License-Identifier: MIT

config SHIELD_PAVLO1_LEFT
    def_bool $(shields_list_contains,pavlo1_left)

config SHIELD_PAVLO1_RIGHT
    def_bool $(shields_list_contains,pavlo1_right)
```

## config/boards/shields/pavlo1/Kconfig.defconfig
```kconfig
# Copyright (c) 2020 The ZMK Contributors
# SPDX-License-Identifier: MIT

if SHIELD_PAVLO1_LEFT

config ZMK_KEYBOARD_NAME
    default "pavlo1"

config ZMK_SPLIT_ROLE_CENTRAL
    default y

endif

if SHIELD_PAVLO1_LEFT || SHIELD_PAVLO1_RIGHT

config ZMK_SPLIT
    default y

endif
```

## config/boards/shields/pavlokbd/Kconfig.defconfig
```kconfig
# Copyright (c) 2020 The ZMK Contributors
# SPDX-License-Identifier: MIT

if SHIELD_PAVLOKBD_LEFT

config ZMK_KEYBOARD_NAME
    default "pavlokbd"

config ZMK_SPLIT_ROLE_CENTRAL
    default y

endif

if SHIELD_PAVLOKBD_LEFT || SHIELD_PAVLOKBD_RIGHT

config ZMK_SPLIT
    default y

endif
```

## config/boards/shields/pavlokbd/Kconfig.shield
```kconfig
# Copyright (c) 2020 The ZMK Contributors
# SPDX-License-Identifier: MIT

config SHIELD_PAVLOKBD_LEFT
    def_bool $(shields_list_contains,pavlokbd_left)

config SHIELD_PAVLOKBD_RIGHT
    def_bool $(shields_list_contains,pavlokbd_right)
```
